## esp_webcam/main/Kconfig.projbuild
```kconfig
menu "ESP webcam"
config WEBCAM_WIFI_SSID
    string "Wi-Fi SSID (local sdkconfig only)"
    default ""
    help
        Fallback when no serial network settings have been saved in NVS.
        Use UART command wifi, then reboot, to configure without rebuilding.
config WEBCAM_WIFI_PASSWORD
    string "Wi-Fi password (local sdkconfig only)"
    default ""
    help
        Fallback only. Saved UART network settings take precedence.
config WEBCAM_NVS_ENCRYPTION
    bool "Encrypt NVS (cloud settings, tokens, Wi-Fi credentials)"
    default y
    help
        Initialize the default NVS partition with the XTS-AES keys stored in
        the nvs_keys partition. New devices generate the keys on first boot.
        If the key partition is missing or encrypted init fails, the firmware
        falls back to unencrypted NVS so existing devices stay bootable.
        Disable this to initialize NVS without encryption. A device that
        already holds encrypted NVS must be erased and reprovisioned when this
        option is changed.
config WEBCAM_CAMERA_FPS
    int "UVC capture FPS (10 or 15 for 1280x720)"
    range 6 30
    default 10
    help
        The capture resolution is fixed at 1280x720 (HD) because HD is a
        product requirement. The target camera advertises 10 and 15 fps and
        the UVC driver requires an exact match. Capture may run faster than
        the send target so the sender always has a fresh frame.
config WEBCAM_TARGET_FPS
    int "Wi-Fi/WebRTC/MJPEG send target FPS"
    range 6 30
    default 10
    help
        Send fresh HD frames at up to this rate, including static scenes.
        The minimum requirement is 6 fps; 10 fps leaves headroom for losses.
        Actual display FPS must be measured; a target is not a guarantee.
        Keep the UVC capture rate at least as high as the send target.
config WEBCAM_DATACHANNEL_RETRANSMITS
    int "DataChannel max retransmits per message (0 = unreliable)"
    range 0 3
    default 0
    help
        0 sends each JPEG chunk once. An incomplete frame is discarded by the
        browser and replaced by the next frame, which saves retransmission
        bandwidth on a lossy Wi-Fi link.
config WEBCAM_SIGNALING_URL
    string "Edge Bridge base URL (empty disables WebRTC)"
    default "http://192.168.137.1:8787"
    help
        Saved UART network settings take precedence. Use the signaling
        command, then reboot, to change the server without rebuilding.
        Base URL of tolo-edge-bridge. The ESP calls IssueFirestoreToken and
        then reads/writes the Firestore signaling documents. Use an address
        the ESP can reach. http:// defaults to port 8080 and https:// to 443.
        HTTPS validates the server with the ESP-IDF CA bundle. Leave empty to
        run the MJPEG diagnostics without WebRTC.
config WEBCAM_EDGE_DEVICE_ID
    string "Edge device ID (16 lowercase hex)"
    default ""
    help
        Public ID of this ESP camera in the signaling path. It is not a
        credential. Use the same value in the observation page's ?camera=.
config WEBCAM_IDP_URL
    string "IdP issuer base URL (empty = provisioning only)"
    default ""
    help
        Base URL of the IdP issuer, for example https://auth.example.com.
        The ESP calls /oauth2/device_authorization and /oauth2/token on this
        origin. Must be an HTTP(S) origin with no path or trailing slash.
        Web Serial provisioning normally supplies this value.
config WEBCAM_FIREBASE_PROJECT_ID
    string "Firebase project ID"
    default ""
config WEBCAM_FIREBASE_API_KEY
    string "Firebase Web API key"
    default ""
config WEBCAM_FIRESTORE_EMULATOR_HOST
    string "Firestore emulator host:port (empty = production)"
    default ""
config WEBCAM_AUTH_EMULATOR_HOST
    string "Firebase Auth emulator host:port (empty = production)"
    default ""
config WEBCAM_STUN_URL
    string "STUN server URL (empty disables)"
    default "stun:stun.l.google.com:19302"
    help
        STUN server used by the ESP ICE agent. Keep it aligned with the
        observation page's ICE_SERVERS in tolo-web. STUN only discovers the
        server-reflexive address; TURN relay and authentication are not
        configured. Leave empty on a LAN without Internet access to use host
        candidates only.
config WEBCAM_CAMERA_VID
    hex "UVC camera VID (0 matches any vendor)"
    range 0x0 0xffff
    default 0x349c
config WEBCAM_CAMERA_PID
    hex "UVC camera PID (0 matches any product)"
    range 0x0 0xffff
    default 0x3307
endmenu
```

## esp_webcam/sdkconfig.defaults
```kconfig
CONFIG_ESPTOOLPY_FLASHSIZE_8MB=y
CONFIG_PARTITION_TABLE_CUSTOM=y
CONFIG_PARTITION_TABLE_CUSTOM_FILENAME="partitions.csv"
CONFIG_NVS_ENCRYPTION=y
# nvs_boot.c reads the nvs_keys partition directly; do not let nvs_sec_provider
# select flash-encryption or HMAC key handling for nvs_flash_init().
CONFIG_NVS_SEC_KEY_PROTECT_NONE=y
CONFIG_WEBCAM_NVS_ENCRYPTION=y
CONFIG_ESP_DEFAULT_CPU_FREQ_MHZ_240=y
CONFIG_SPIRAM=y
CONFIG_SPIRAM_MODE_OCT=y
CONFIG_SPIRAM_SPEED_80M=y
CONFIG_SPIRAM_USE_MALLOC=y
CONFIG_ESP_CONSOLE_UART_DEFAULT=y
CONFIG_ESP_CONSOLE_SECONDARY_NONE=y
CONFIG_ESP_WIFI_ENTERPRISE_SUPPORT=y
CONFIG_ESP_WIFI_MBEDTLS_TLS_CLIENT=y
CONFIG_ESP_WIFI_SUITE_B_192=y
CONFIG_MBEDTLS_CERTIFICATE_BUNDLE=y
CONFIG_MBEDTLS_CERTIFICATE_BUNDLE_CROSS_SIGNED_VERIFY=y
CONFIG_FREERTOS_HZ=1000
CONFIG_MBEDTLS_SSL_PROTO_DTLS=y
CONFIG_MBEDTLS_SSL_DTLS_SRTP=y
CONFIG_MBEDTLS_X509_CREATE_C=y
CONFIG_HTTPD_MAX_REQ_HDR_LEN=2048
CONFIG_HTTPD_MAX_URI_LEN=512
CONFIG_USB_HOST_CONTROL_TRANSFER_MAX_SIZE=4096
CONFIG_USB_HOST_HW_BUFFER_BIAS_IN=y
CONFIG_LWIP_MAX_SOCKETS=20
CONFIG_COMPILER_OPTIMIZATION_PERF=y
CONFIG_LWIP_IRAM_OPTIMIZATION=y
CONFIG_LWIP_TCPIP_RECVMBOX_SIZE=64
CONFIG_LWIP_UDP_RECVMBOX_SIZE=32
CONFIG_ESP_WIFI_DYNAMIC_TX_BUFFER_NUM=48
CONFIG_ESP_WIFI_TX_BA_WIN=12
CONFIG_MBEDTLS_CHACHA20_C=y
CONFIG_MBEDTLS_CHACHAPOLY_C=y
CONFIG_MBEDTLS_ASYMMETRIC_CONTENT_LEN=y
# DTLS datagrams are capped at 1500 bytes; save 12 KiB per receive context.
CONFIG_MBEDTLS_SSL_IN_CONTENT_LEN=4096
CONFIG_MBEDTLS_SSL_OUT_CONTENT_LEN=4096
```

## tab5_camera/c6_coprocessor/sdkconfig.defaults
```kconfig
CONFIG_IDF_TARGET="esp32c6"
CONFIG_ESP_HOSTED=y
CONFIG_ESP_HOSTED_CP=y
CONFIG_ESP_HOSTED_CP_FOR_MCU=y
CONFIG_ESP_HOSTED_CP_RPC_V2=y
CONFIG_ESP_HOSTED_CP_FEAT_WIFI=y
CONFIG_ESP_HOSTED_CP_FEAT_WIFI_EXT_ENT=y
CONFIG_ESP_WIFI_ENTERPRISE_SUPPORT=y
CONFIG_ESP_WIFI_MBEDTLS_TLS_CLIENT=y
CONFIG_ESP_WIFI_SUITE_B_192=y
CONFIG_MBEDTLS_CERTIFICATE_BUNDLE=y
CONFIG_MBEDTLS_CERTIFICATE_BUNDLE_CROSS_SIGNED_VERIFY=y
CONFIG_BT_ENABLED=n
CONFIG_ESPTOOLPY_FLASHSIZE_4MB=y
CONFIG_PARTITION_TABLE_CUSTOM=y
CONFIG_PARTITION_TABLE_CUSTOM_FILENAME="partitions_eh_cp_ota_4m.csv"
CONFIG_FREERTOS_HZ=1000
CONFIG_ESP_WIFI_NVS_ENABLED=y
CONFIG_ESP_DEFAULT_CPU_FREQ_MHZ_160=y
CONFIG_BT_LE_HCI_INTERFACE_USE_RAM=y
CONFIG_ESP_CACHE_MALLOC=y
CONFIG_ESP_WIFI_STATIC_RX_BUFFER_NUM=20
CONFIG_ESP_WIFI_DYNAMIC_RX_BUFFER_NUM=64
CONFIG_ESP_WIFI_DYNAMIC_TX_BUFFER_NUM=64
CONFIG_ESP_WIFI_AMPDU_TX_ENABLED=y
CONFIG_ESP_WIFI_TX_BA_WIN=32
CONFIG_ESP_WIFI_AMPDU_RX_ENABLED=y
CONFIG_ESP_WIFI_RX_BA_WIN=32
CONFIG_ESP_WIFI_RX_IRAM_OPT=y
CONFIG_ESP_WIFI_IRAM_OPT=y
CONFIG_COMPILER_OPTIMIZATION_PERF=y
```

## tab5_camera/main/Kconfig.projbuild
```kconfig
menu "Tab5 camera"
config WEBCAM_ALLOW_INSECURE_HTTP
    bool "Allow credential transmission over HTTP (development only)"
    default n
    help
        Permit HTTP IdP, Edge Bridge and Firebase emulator endpoints only
        for isolated development. HTTP exposes access and refresh tokens.
        Production builds require HTTPS, including saved NVS endpoints.

config WEBCAM_WIFI_SSID
    string "Wi-Fi SSID (local sdkconfig only)"
    default ""
    help
        Fallback when no serial network settings have been saved in NVS.
        Use UART command wifi, then reboot, to configure without rebuilding.
config WEBCAM_WIFI_PASSWORD
    string "Wi-Fi password (local sdkconfig only)"
    default ""
    help
        Fallback only. Saved UART network settings take precedence.
config WEBCAM_NVS_ENCRYPTION
    bool "Encrypt NVS (cloud settings, tokens, Wi-Fi credentials)"
    default y
    help
        Initialize the default NVS partition with the XTS-AES keys stored in
        the nvs_keys partition. New devices generate the keys on first boot.
        If the key partition is missing or encrypted init fails, the firmware
        falls back to unencrypted NVS so existing devices stay bootable.
        Disable this to initialize NVS without encryption. A device that
        already holds encrypted NVS must be erased and reprovisioned when this
        option is changed.
config WEBCAM_NVS_REQUIRE_ENCRYPTION
    bool "Fail closed when NVS encryption is unavailable"
    default n
    depends on WEBCAM_NVS_ENCRYPTION
    help
        Stop boot if NVS encryption cannot be initialized instead of falling
        back to plaintext. Enable this in production/secure builds. The
        secure configuration uses an HMAC key burnt in eFuse; see
        sdkconfig.secure.defaults and the README.
config WEBCAM_SIGNALING_URL
    string "Edge Bridge base URL (empty disables WebRTC)"
    default "http://192.168.137.1:8787"
    help
        Saved UART network settings take precedence. Use the signaling
        command, then reboot, to change the server without rebuilding.
        Base URL of tolo-edge-bridge. The ESP calls IssueFirestoreToken and
        then reads/writes the Firestore signaling documents. Use an address
        the ESP can reach. Production builds require HTTPS. HTTP and bare
        hosts are accepted only with WEBCAM_ALLOW_INSECURE_HTTP enabled.
        HTTPS validates the server with the ESP-IDF CA bundle. Leave empty to
        run the MJPEG diagnostics without WebRTC.
config WEBCAM_EDGE_DEVICE_ID
    string "Edge device ID (16 lowercase hex)"
    default ""
    help
        Public ID of this ESP camera in the signaling path. It is not a
        credential. Use the same value in the observation page's ?camera=.
config WEBCAM_IDP_URL
    string "IdP issuer base URL (empty = provisioning only)"
    default ""
    help
        Base URL of the IdP issuer, for example https://auth.example.com.
        The ESP calls /oauth2/device_authorization and /oauth2/token on this
        origin. Must be an HTTPS origin with no path or trailing slash.
        HTTP is allowed only with WEBCAM_ALLOW_INSECURE_HTTP enabled.
        Web Serial provisioning normally supplies this value.
config WEBCAM_FIREBASE_PROJECT_ID
    string "Firebase project ID"
    default ""
config WEBCAM_FIREBASE_API_KEY
    string "Firebase Web API key"
    default ""
config WEBCAM_FIRESTORE_EMULATOR_HOST
    string "Firestore emulator host:port (empty = production)"
    default ""
config WEBCAM_AUTH_EMULATOR_HOST
    string "Firebase Auth emulator host:port (empty = production)"
    default ""
config WEBCAM_STUN_URL
    string "STUN server URL (empty disables)"
    default "stun:stun.l.google.com:19302"
    help
        STUN server used by the ESP ICE agent. Keep it aligned with the
        observation page's ICE_SERVERS in tolo-web. STUN only discovers the
        server-reflexive address; TURN relay and authentication are not
        configured. Leave empty on a LAN without Internet access to use host
        candidates only.
config TAB5_VIDEO_FPS
    int "H.264 capture and send FPS"
    range 6 30
    default 15
config TAB5_VIDEO_BITRATE
    int "H.264 target bitrate (bps)"
    range 300000 8000000
    default 2000000
config TAB5_VIDEO_GOP
    int "H.264 keyframe interval (frames)"
    range 1 300
    default 15
endmenu
```

## tab5_camera/sdkconfig.defaults
```kconfig
CONFIG_IDF_TARGET="esp32p4"
CONFIG_ESP32P4_SELECTS_REV_LESS_V3=y
CONFIG_ESP32P4_REV_MIN_100=y
CONFIG_ESPTOOLPY_FLASHSIZE_16MB=y
CONFIG_ESPTOOLPY_FLASHMODE_QIO=y
CONFIG_PARTITION_TABLE_CUSTOM=y
CONFIG_PARTITION_TABLE_CUSTOM_FILENAME="partitions.csv"
CONFIG_NVS_ENCRYPTION=y
CONFIG_NVS_SEC_KEY_PROTECT_NONE=y
CONFIG_WEBCAM_NVS_ENCRYPTION=y
CONFIG_ESP_DEFAULT_CPU_FREQ_MHZ_360=y
CONFIG_SPIRAM=y
CONFIG_SPIRAM_MODE_HEX=y
CONFIG_SPIRAM_SPEED_200M=y
CONFIG_SPIRAM_USE_MALLOC=y
CONFIG_ESP_CONSOLE_USB_SERIAL_JTAG=y
CONFIG_ESP_CONSOLE_SECONDARY_NONE=y
CONFIG_SLAVE_IDF_TARGET_ESP32C6=y
CONFIG_ESP_HOSTED_MEMPOOL_PREFER_SPIRAM=y
CONFIG_CAMERA_SC202CS=y
CONFIG_CAMERA_SC202CS_MIPI_RAW8_1280X720_30FPS=y
CONFIG_CAMERA_SC202CS_MIPI_DEFAULT_FMT_RAW8_1280X720_30FPS=y
CONFIG_ESP_VIDEO_ENABLE_ISP_PIPELINE_CONTROLLER=y
CONFIG_MBEDTLS_CERTIFICATE_BUNDLE=y
CONFIG_MBEDTLS_CERTIFICATE_BUNDLE_CROSS_SIGNED_VERIFY=y
CONFIG_FREERTOS_HZ=1000
CONFIG_MBEDTLS_SSL_PROTO_DTLS=y
CONFIG_MBEDTLS_SSL_DTLS_SRTP=y
CONFIG_MBEDTLS_X509_CREATE_C=y
CONFIG_LWIP_MAX_SOCKETS=20
CONFIG_COMPILER_OPTIMIZATION_PERF=y
CONFIG_LWIP_IRAM_OPTIMIZATION=y
CONFIG_LWIP_TCPIP_RECVMBOX_SIZE=64
CONFIG_LWIP_UDP_RECVMBOX_SIZE=32
CONFIG_MBEDTLS_CHACHA20_C=y
CONFIG_MBEDTLS_CHACHAPOLY_C=y
CONFIG_MBEDTLS_ASYMMETRIC_CONTENT_LEN=y
CONFIG_MBEDTLS_SSL_IN_CONTENT_LEN=4096
CONFIG_MBEDTLS_SSL_OUT_CONTENT_LEN=4096
CONFIG_ESP_MAIN_TASK_STACK_SIZE=12288
CONFIG_ESP_VIDEO_ENABLE_HW_H264_VIDEO_DEVICE=y
CONFIG_ESP32P4_TAB5_C6_BOARD=y
# CONFIG_ESP_HOSTED_AUTO_CALL_INIT_BEFORE_APP_MAIN is not set
CONFIG_CAMERA_SC202CS_CUSTOMIZED_IPA_JSON_CONFIGURATION_FILE=y
CONFIG_CAMERA_SC202CS_CUSTOMIZED_IPA_JSON_CONFIGURATION_FILE_PATH="sc202cs_ipa_rev1.json"
CONFIG_LV_FONT_MONTSERRAT_28=y
CONFIG_LV_FONT_MONTSERRAT_40=y
CONFIG_LV_FONT_MONTSERRAT_48=y
```
